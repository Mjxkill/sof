## src/audio/deinterleave_8/Kconfig
```kconfig
# SPDX-License-Identifier: BSD-3-Clause

config COMP_DEINTERLEAVE_8
	bool "Deinterleave 1×8ch -> 8 mono component (V5.4.1 Phase 1a.3)"
	default n
	help
	  Split 1 source 8-channel interleaved S32_LE into 8 mono sinks.
	  Used at start of V5.4.1 input chain (SAI7 RX 8ch -> 8 strips IN mono).
	  Symetric pattern to interleave_8. SOURCE_SINK mode.
```

## src/audio/interleave_8/Kconfig
```kconfig
# SPDX-License-Identifier: BSD-3-Clause

config COMP_INTERLEAVE_8
	bool "Interleave 8 mono -> 1x8ch component (V5.4.1 Phase 1a.3)"
	default n
	help
	  Concatenate 8 mono sources into a single 8-channel interleaved
	  S32_LE sink. Used at end of V5.4.1 output chain to deliver 8
	  channels to SAI7 TX (NPU tap V3.2.2 invariant: period_bytes=3072).
	  SOURCE_SINK mode. Skeleton at E1 — full memcpy stride at E2.
```

## src/audio/matrix_2x8/Kconfig
```kconfig
# SPDX-License-Identifier: BSD-3-Clause

config COMP_MATRIX_2X8
	bool "Matrix 2x8 -> 8 native interleaved component (V5.4.1 Phase 1a.3 E6.b)"
	default y
	help
	  Native 8-channel interleaved matrix mixer: 2 sources x 8ch -> 1 sink x 8ch.
	  Per-cell Q1.31 gains form a 16x8 matrix (128 cells = 512 B ALSA bytes blob).
	  Replaces the mixer16 + deinterleave_8 x 2 + interleave_8 chain by keeping
	  data 8ch interleaved end-to-end, eliminating mono branched buffers and the
	  related F++ / pipeline_complete walk-not-visited issues. Used at the V5.4.1
	  matrix routing stage between input strips (8 mics post-strip-IN) and the
	  ASIO play 8ch on one side, and the 8 strip-OUT inputs on the other.
```

## src/audio/mixer16/Kconfig
```kconfig
# SPDX-License-Identifier: BSD-3-Clause

config COMP_MIXER16
	bool "Mixer 16x8 matrix component (V5.4.1 Phase 1a.3)"
	default n
	help
	  16-source x 8-sink matrix mixer with per-cell Q1.31 gains.
	  Used for V5.4.1 routing matrix between input strips and output
	  strips (8 mics + 8 ASIO playback hosts -> 8 strip OUT). SOURCE_SINK
	  mode (proc_type=SOURCE_SINK). 128 gain cells exposed as ALSA bytes
	  blob (512 B). Requires MODULE_MAX_SOURCES >= 16 (C14).
	  Skeleton only at E1 — full mix loop at E2.
```

## src/audio/tee_1to2/Kconfig
```kconfig
# SPDX-License-Identifier: BSD-3-Clause

config COMP_TEE_1TO2
	bool "TEE 1-to-2 fan-out component (V5.4.1 Phase 1a.3)"
	default n
	help
	  Minimal fan-out component for V5.4.1 channel-strip post-IN duplication.
	  1 mono source -> 2 mono sinks (identical content). STREAM mode.
	  Used to split each input channel-strip into matrix-input + capture-host
	  branches (V5.4.1 §2 fan-out post-strip-IN).
```
